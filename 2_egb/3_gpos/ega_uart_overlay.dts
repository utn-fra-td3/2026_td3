/dts-v1/;
/plugin/;

/ {
    compatible = "brcm,bcm2835";

    fragment@0 {
        target = <&uart1>;
        __overlay__ {
            status = "okay";

            ega_uart {
                compatible = "brian,ega-uart";
                status = "okay";
            };
        };
    };
};
